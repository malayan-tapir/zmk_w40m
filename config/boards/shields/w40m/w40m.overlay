#include "w40m.dtsi"

/ {
    chosen {
        zmk,kscan = &kscan0;
    };

    kscan0: kscan_0 {
        compatible = "zmk,kscan-gpio-charlieplex";
        interrupt-gpios = <&xiao_d 8 GPIO_ACTIVE_LOW>;
        gpios = <&xiao_d 0 GPIO_ACTIVE_LOW>,
                <&xiao_d 1 GPIO_ACTIVE_LOW>,
                <&xiao_d 2 GPIO_ACTIVE_LOW>,
                <&xiao_d 3 GPIO_ACTIVE_LOW>,
                <&xiao_d 4 GPIO_ACTIVE_LOW>,
                <&xiao_d 5 GPIO_ACTIVE_LOW>,
                <&xiao_d 6 GPIO_ACTIVE_LOW>,
                <&xiao_d 7 GPIO_ACTIVE_LOW>;
    };
};

&xiao_serial {
    status = "disabled";
};
